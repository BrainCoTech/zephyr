## boards/arm/gd32f403z_eval/gd32f403z_eval_defconfig
```kconfig
# Copyright (c) 2021, ATL Electronics
# SPDX-License-Identifier: Apache-2.0

CONFIG_SOC_SERIES_GD32F403=y
CONFIG_SOC_PART_NUMBER_GD32F403ZET6=y
CONFIG_BOARD_GD32F403Z_EVAL=y
CONFIG_BUILD_OUTPUT_HEX=y

CONFIG_ARM_MPU=y
CONFIG_HW_STACK_PROTECTION=y
CONFIG_CORTEX_M_SYSTICK=y

CONFIG_CONSOLE=y
CONFIG_UART_CONSOLE=y
CONFIG_SERIAL=y
CONFIG_PRINTK=y
```

## drivers/sensor/max30001/Kconfig
```kconfig
# Copyright 2022 BrainCo Inc.
#
# SPDX-License-Identifier: Apache-2.0

menuconfig MAX30001
	bool "MAX30001 Biopotential and BioZ AFE"
	depends on SPI
	help
	  Enable MAX30001 Biopotential and BioZ AFE driver

if MAX30001

config MAX30001_TRIGGER_GLOBAL_THREAD
	bool "Use global thread"
	depends on GPIO

config MAX30001_TRIGGER_OWN_THREAD
	bool "Use own thread"
	depends on GPIO

config MAX30001_THREAD_PRIORITY
	int "Thread priority"
	depends on MAX30001_TRIGGER_OWN_THREAD
	default 10
	help
	  Priority of thread used by the driver to handle interrupts.

config MAX30001_THREAD_STACK_SIZE
	int "Max30001 interrupts handler thread stack size"
	depends on MAX30001_TRIGGER_OWN_THREAD
	default 1024
	help
	  Stack size of thread used by the driver to handle interrupts.

config MAX30001_LEAD_DETECTION
	bool "MAX30001 lead on/off detection"
	help
	  Enable Lead on/off detection.

endif # MAX30001
```

## drivers/spi/Kconfig.gd32
```kconfig
# Copyright (c) 2021 BrainCo Inc.
# SPDX-License-Identifier: Apache-2.0

menuconfig SPI_GD32
	bool "Gigadevice GD32 SPI controller driver"
	depends on SOC_FAMILY_GD32
	select USE_GD32_SPI
	help
	  Enables Gigadevice GD32 SPI controller support.

if SPI_GD32

config SPI_GD32_INTERRUPT
	bool "GD32 SPI interrupt support"
	help
	  Ennable GD32 SPI interrupt support.

endif # SPI_GD32
```

## dts/bindings/arm/gd,gd32-ccm.yaml
```yaml
# SPDX-License-Identifier: Apache-2.0

description: GD32 CCM (Core Coupled Memory)

compatible: "gd,gd32-ccm"

include: base.yaml

properties:
    reg:
      required: true
```

## dts/bindings/sensor/maxim,max30001.yaml
```yaml
# Copyright (c) 2022 BrainCo Inc.
# SPDX-License-Identifier: Apache-2.0

description: MAX30001 Biopentional and BioZ sensor.

compatible: "maxim,max30001"

include: spi-device.yaml

properties:
  intb-gpios:
    type: phandle-array
    required: true
    description: INTB interrupt input

  ecg-sample-rate:
    type: int
    required: true
    description: |
      ECG channel sample rate.
        0  512sps
        1  256sps
        2  128sps
    enum:
      - 0
      - 1
      - 2

  lead-off-imag:
    type: int
    required: false
    description: |
      DC Lead-Off Current Magnitude, nA
        0  0nA
        1  5nA
        2  10nA
        3  20nA
        4  50nA
        5  100nA
    enum:
      - 0
      - 1
      - 2
      - 3
      - 4
      - 5

  lead-off-vth:
    type: int
    required: false
    description: |
      DC Lead-Off Voltage Threshold, mV
        0  300mV
        1  400mV
        2  450mV
        3  500mV
    enum:
      - 0
      - 1
      - 2
      - 3
```

## soc/arm/gigadevice/gd32f/Kconfig.defconfig.gd32f403
```kconfig
# Copyright (c) 2021, ATL Electronics
# SPDX-License-Identifier: Apache-2.0

if SOC_SERIES_GD32F403

config SOC_SERIES
	default "gd32f"

config SOC_SUB_SERIES
	string
	default "gd32f403"

config SOC_PART_NUMBER
	default "gd32f403rct6" if SOC_PART_NUMBER_GD32F403RCT6
	default "gd32f403ret6" if SOC_PART_NUMBER_GD32F403RET6
	default "gd32f403rgt6" if SOC_PART_NUMBER_GD32F403RGT6
	default "gd32f403rit6" if SOC_PART_NUMBER_GD32F403RIT6
	default "gd32f403rkt6" if SOC_PART_NUMBER_GD32F403RKT6
	default "gd32f403vch6" if SOC_PART_NUMBER_GD32F403VCH6
	default "gd32f403vct6" if SOC_PART_NUMBER_GD32F403VCT6
	default "gd32f403veh6" if SOC_PART_NUMBER_GD32F403VEH6
	default "gd32f403vet6" if SOC_PART_NUMBER_GD32F403VET6
	default "gd32f403vgh6" if SOC_PART_NUMBER_GD32F403VGH6
	default "gd32f403vgt6" if SOC_PART_NUMBER_GD32F403VGT6
	default "gd32f403vih6" if SOC_PART_NUMBER_GD32F403VIH6
	default "gd32f403vit6" if SOC_PART_NUMBER_GD32F403VIT6
	default "gd32f403vkh6" if SOC_PART_NUMBER_GD32F403VKH6
	default "gd32f403vkt6" if SOC_PART_NUMBER_GD32F403VKT6
	default "gd32f403zct6" if SOC_PART_NUMBER_GD32F403ZCT6
	default "gd32f403zet6" if SOC_PART_NUMBER_GD32F403ZET6
	default "gd32f403zgt6" if SOC_PART_NUMBER_GD32F403ZGT6
	default "gd32f403zit6" if SOC_PART_NUMBER_GD32F403ZIT6
	default "gd32f403zkt6" if SOC_PART_NUMBER_GD32F403ZKT6

config SYS_CLOCK_HW_CYCLES_PER_SEC
	default 168000000

config NUM_IRQS
	default 68

endif   # SOC_SERIES_GD32F403
```

## soc/arm/gigadevice/gd32f/Kconfig.defconfig.gd32f405
```kconfig
# Copyright (c) 2021, ATL Electronics
# SPDX-License-Identifier: Apache-2.0

if SOC_SERIES_GD32F405

config SOC_SERIES
	default "gd32f"

config SOC_SUB_SERIES
	string
	default "gd32f405"

config SOC_PART_NUMBER
	default "gd32f405vgt6" if SOC_PART_NUMBER_GD32F405VGT6

config SYS_CLOCK_HW_CYCLES_PER_SEC
	default 168000000

config NUM_IRQS
	default 82

endif   # SOC_SERIES_GD32F405
```

## soc/arm/gigadevice/gd32f/Kconfig.soc
```kconfig
# Copyright (c) 2021, ATL Electronics
# SPDX-License-Identifier: Apache-2.0

source "soc/arm/gigadevice/gd32f/Kconfig.soc.gd32f403"
```

## soc/arm/gigadevice/gd32f/Kconfig.soc.gd32f403
```kconfig
# Copyright (c) 2021, ATL Electronics
# SPDX-License-Identifier: Apache-2.0

choice
	prompt "GigaDevice GD32F403 MCU Selection"
	depends on SOC_SERIES_GD32F403

	config SOC_PART_NUMBER_GD32F403RCT6
		bool "GD32F403RCT6"

	config SOC_PART_NUMBER_GD32F403RET6
		bool "GD32F403RET6"

	config SOC_PART_NUMBER_GD32F403RGT6
		bool "GD32F403RGT6"

	config SOC_PART_NUMBER_GD32F403RIT6
		bool "GD32F403RIT6"

	config SOC_PART_NUMBER_GD32F403RKT6
		bool "GD32F403RKT6"

	config SOC_PART_NUMBER_GD32F403VCH6
		bool "GD32F403VCH6"

	config SOC_PART_NUMBER_GD32F403VCT6
		bool "GD32F403VCT6"

	config SOC_PART_NUMBER_GD32F403VEH6
		bool "GD32F403VEH6"

	config SOC_PART_NUMBER_GD32F403VET6
		bool "GD32F403VET6"

	config SOC_PART_NUMBER_GD32F403VGH6
		bool "GD32F403VGH6"

	config SOC_PART_NUMBER_GD32F403VGT6
		bool "GD32F403VGT6"

	config SOC_PART_NUMBER_GD32F403VIH6
		bool "GD32F403VIH6"

	config SOC_PART_NUMBER_GD32F403VIT6
		bool "GD32F403VIT6"

	config SOC_PART_NUMBER_GD32F403VKH6
		bool "GD32F403VKH6"

	config SOC_PART_NUMBER_GD32F403VKT6
		bool "GD32F403VKT6"

	config SOC_PART_NUMBER_GD32F403ZCT6
		bool "GD32F403ZCT6"

	config SOC_PART_NUMBER_GD32F403ZET6
		bool "GD32F403ZET6"

	config SOC_PART_NUMBER_GD32F403ZGT6
		bool "GD32F403ZGT6"

	config SOC_PART_NUMBER_GD32F403ZIT6
		bool "GD32F403ZIT6"

	config SOC_PART_NUMBER_GD32F403ZKT6
		bool "GD32F403ZKT6"
endchoice
```

## soc/arm/gigadevice/gd32f/Kconfig.soc.gd32f405
```kconfig
# Copyright (c) 2021, ATL Electronics
# SPDX-License-Identifier: Apache-2.0

choice
	prompt "GigaDevice GD32F405 MCU Selection"
	depends on SOC_SERIES_GD32F405

	config SOC_PART_NUMBER_GD32F405VGT6
		bool "GD32F405VGT6"

endchoice
```
